#include "timer.h"
#include "common.h"
#include "uart.h"
/*
TA0.0 P1.1      TA1.0 P1.7      TA2.0
TA0.1 P1.2      TA1.1 P2.0      TA2.1
TA0.2 P1.3      TA1.2 P2.1      TA2.2
TA0.3 P1.4      
TA0.4 P1.5
*/


int data = 0;//查表计数
float MOD = 1.0;
int i = 0;
float test[250]={0};
/*******************定义三相波表**************************/

const int SIN1[250]={
320,326,333,340,347,353,360,367,373,380,387,393,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558,
554,551,547,544,540,536,532,528,523,519,514,509,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88,
85,81,78,75,72,70,67,65,63,61,59,57,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313
};
const int SIN2[250]={
554,551,547,544,540,536,532,528,523,519,514,509,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88,
85,81,78,75,72,70,67,65,63,61,59,57,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313,
320,326,333,340,347,353,360,367,373,380,387,393,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558,
};
const int SIN3[250]={
85,81,78,75,72,70,67,65,63,61,59,57,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313,
320,326,333,340,347,353,360,367,373,380,387,393,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558,
554,551,547,544,540,536,532,528,523,519,514,509,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88
};


void Timer0_Init()
{
  TA0CTL = 0;  
  P1DIR |=BIT2+BIT3+BIT4;     //输出方向
  P1SEL |=BIT2+BIT3+BIT4;     //第二功能
  
  TA0CTL = TASSEL_2 + ID_0 + MC_3  + TACLR ; //选择时钟源+增计数模式+计数器清零
  TA0CCR0 = 640;                  
  //占空比TA0CCRx/TA0CCR0
  
  TA0CCR1 = 320;
  TA0CCTL1=OUTMOD_2 ;                 
  
  TA0CCR2 = 320;
  TA0CCTL2=OUTMOD_2;
  
  TA0CCR3 = 320;
  TA0CCTL3=OUTMOD_2 ;
  
  
}

#pragma vector = TIMER0_A1_VECTOR  
__interrupt void TIMER0_A1(void)
{
   __disable_interrupt();
  switch(TA0IV)
  {
      case 14:         
      
         TA0CCR1 = SIN1[data];
         TA0CCR2 = SIN2[data];
         TA0CCR3 = SIN3[data];
         
      /*   TA0CCR1 = (uint32)((SIN1[data]-320)*MOD+320);
         TA0CCR2 = (uint32)((SIN1[data]-320)*MOD+320);
         TA0CCR3 = (uint32)((SIN1[data]-320)*MOD+320);
       */ 
         data++;
         if(data == 250 )
         {
            data =0 ;
         } 
         break;
  }
 
   __enable_interrupt(); 
}



void Timer2_Init(void)
{
  P2DIR &=~BIT4;                            //配置捕捉端口（p2.4）
  P2SEL |= BIT4; 
 
  TA2CTL=0;                               //清除以前设置2
  TA2CTL = TASSEL_2+ID_0+MC_2+TAIE+TACLR; // TASSEL_2选择辅助时钟SMCLK+0分频+计数上线FFFFH; 
  TA2CCTL1 = CAP+CM_1+CCIS_0+SCS+CCIE;    //捕获模式+上升沿捕获+选择捕获源+同步捕获+使能中断
}

#pragma vector = TIMER2_A1_VECTOR
__interrupt void TIMER2_A1(void)
{
    __disable_interrupt();
    switch( TA2IV )
    {
      case 2:
             data = 0;              //跟踪相位
             break;                //TA1CCR1
             
      case 14:
              break;               //溢出中断
      
    }
    __enable_interrupt();
}
